## firmware/main/Kconfig.projbuild
```kconfig
menu "AIS Display"

    # Set by the board's sdkconfig.defaults.<board>, which CMakeLists.txt picks
    # from AIS_BOARD (build.sh <board>). See BOARDS_PLAN.md.
    choice AIS_BOARD
        prompt "Board"
        default AIS_BOARD_LCD34C

        config AIS_BOARD_LCD34C
            bool "Waveshare ESP32-P4-WIFI6-Touch-LCD-3.4C (800x800 round)"
        config AIS_BOARD_LCD4C
            bool "Waveshare ESP32-P4-WIFI6-Touch-LCD-4C (720x720 round)"
        config AIS_BOARD_LCD10
            bool "Waveshare ESP32-P4-WIFI6-Touch-LCD-10.1 (1280x800, landscape)"
        config AIS_BOARD_HEADLESS
            bool "Waveshare ESP32-P4 without a screen (WIFI6-POE-ETH, WIFI6-DB)"
    endchoice

    config AIS_BOARD_NAME
        string
        default "lcd34c" if AIS_BOARD_LCD34C
        default "lcd4c" if AIS_BOARD_LCD4C
        default "lcd10" if AIS_BOARD_LCD10
        default "headless" if AIS_BOARD_HEADLESS

    config AIS_BOARD_TITLE
        string
        default "ESP32-P4-WIFI6-Touch-LCD-3.4C" if AIS_BOARD_LCD34C
        default "ESP32-P4-WIFI6-Touch-LCD-4C" if AIS_BOARD_LCD4C
        default "ESP32-P4-WIFI6-Touch-LCD-10.1" if AIS_BOARD_LCD10
        default "ESP32-P4, no screen" if AIS_BOARD_HEADLESS

    # "display" or "headless": the component manager's rules in
    # main/idf_component.yml test this (a string is always written to the
    # sdkconfig; a hidden bool that's "no" isn't, and then counts as missing).
    config AIS_BOARD_KIND
        string
        default "headless" if AIS_BOARD_HEADLESS
        default "display"

    config AIS_HAS_DISPLAY
        bool
        default y if !AIS_BOARD_HEADLESS

    config AIS_DISPLAY_ROUND
        bool
        default y if AIS_BOARD_LCD34C || AIS_BOARD_LCD4C

    config AIS_HAS_ETH
        bool
        default y if AIS_BOARD_HEADLESS

    config AIS_DISPLAY_UPSIDE_DOWN
        bool "Board mounted upside down (USB-C ports at the bottom)"
        depends on AIS_HAS_DISPLAY
        default y
        help
            Rotates the picture and the touch input by 180 degrees, so the board can
            be mounted with its USB-C ports along the bottom edge and the cable
            hanging down. The printed case in enclosure/ is designed for this.
            Turn it off if the USB-C ports are along the top.

    config AIS_SDR_PROBE
        bool "RTL-SDR USB test (temporary)"
        default y
        help
            Starts USB host on the USB-A port and, when an RTL2832U dongle is
            plugged in, logs its details and measures its sample stream over USB.
            Bring-up step for receiving AIS directly (RTL_SDR_PLAN.md, step 1).

    config AIS_TOUCH_SWAP_XY
        int "Touch: swap X and Y (0/1)"
        depends on AIS_HAS_DISPLAY
        range 0 1
        default 0
        help
            Touch orientation fix-ups. The Waveshare BSP defaults (all 0) are used
            unless touches land in the wrong place.

    config AIS_TOUCH_MIRROR_X
        int "Touch: mirror X (0/1)"
        depends on AIS_HAS_DISPLAY
        range 0 1
        default 0

    config AIS_TOUCH_MIRROR_Y
        int "Touch: mirror Y (0/1)"
        depends on AIS_HAS_DISPLAY
        range 0 1
        default 0

endmenu
```
